/*
Smart 12VDC Power System V0.4
28-08-2022
Robert James Hastings
Github CountZero1066

   ###############################################################
   #              Smart 12VDC Power System V0.4                  #
   #                                                             #
   #                                                             #
   #                                                             #
   ###############################################################
   Version Detail:
            -ESPnow communication with Central Node device enabled
            
             Current limiting relay control -absent 

   Hardware:
            ESP32(NodeMCU)
            4 Channel relay
            4x ACS712 20A Range Current Sensor
            AZDelivery I2C 0.96-inch OLED Display SSD1306 128x64
            12VDC @ 10A PSU
*/

#define BLYNK_TEMPLATE_ID           "TMPLUI7H-NqS"
#define BLYNK_DEVICE_NAME           "Quickstart Device"
#define BLYNK_AUTH_TOKEN            "Iyj8j1nEQprFHVfhnZfO-V7hoyU_9csf"

#include <WiFi.h>
#include <WiFiClient.h>
#include <BlynkSimpleEsp32.h>
#include <esp_now.h>

char auth[] = BLYNK_AUTH_TOKEN;
char ssid[] = "Vietnamese Sweatshop";
char pass[] = "Pass1066T23balls";

#include <SPI.h>
#include <Wire.h>
#include <Adafruit_GFX.h>
#include <Adafruit_SSD1306.h>
#include "ACS712.h"

TaskHandle_t Task_Blynk;
TaskHandle_t Task_Draw_Dispaly;

//ACS712  sense_pin_1(36, 3.3, 4095, 185);

#define CHANNEL 1

#define SCREEN_WIDTH 128 // OLED display width, in pixels
#define SCREEN_HEIGHT 64 // OLED display height, in pixels
#define OLED_RESET     -1 // Reset pin # (or -1 if sharing Arduino reset pin)
#define SCREEN_ADDRESS 0x3D ///< See datasheet for Address; 0x3D for 128x64, 0x3C for 128x32
Adafruit_SSD1306 display(SCREEN_WIDTH, SCREEN_HEIGHT, &Wire, OLED_RESET);

#define splash_height   128
#define splash_width    64
#define LOGO_HEIGHT   51
#define LOGO_WIDTH    52

esp_now_peer_info_t slave;
esp_now_peer_info_t peerInfo;

uint8_t broadcastAddress[] = {0x08,0x3A,0xF2,0x6D,0x25,0x78};
uint8_t NewAddress[sizeof(broadcastAddress)];

int relay_1_pin = 13;
int relay_2_pin = 12;
int relay_3_pin = 14;
int relay_4_pin = 27;

int relay_status_1  = 1;
int relay_status_2  = 1;
int relay_status_3  = 1;
int relay_status_4  = 1;

const int A_sensor1 = 36;
//const int A_sensor2 = 35;
//const int A_sensor3 = 32;
//const int A_sensor4 = 33;

double current_draw[3];
int mVperAmp = 100;
double Voltage = 0;
double VRMS = 0;
double AmpsRMS = 0;

//following arrays define the drawn graphics on the SSD1306 display
   int rec1_x[] = {0,0,0,0};
   int rec1_y[] = {0,16,32,48};
   int rec1_h[] = {16,16,16,16};
   int rec1_w[] = {64,64,64,64};
   
   int rec2_x[] = {64,64,64,64};
   int rec2_y[] = {0,16,32,48};
   int rec2_w[] = {96,96,96,96};
   int rec2_h[] = {16,16,16,16};

   int rec3_x[] = {96,96,96,96};
   int rec3_y[] = {0,16,32,48};
   int rec3_w[] = {32,32,32,32};
   int rec3_h[] = {16,16,16,16};
//the arrays below define the cursor position for the SSD1306 display
   int text_c1_x[] = {2,2,2,2};
   int text_c2_x[] = {70,70,70,70};
   int text_c3_x[] = {102,102,102,102};
   int text_c1_y[] = {5,21,37,53};
   int text_c2_y[] = {5,21,37,53};
   int text_c3_y[] = {5,21,37,53};
   

//-------------------------------------------------------------------------------------------
//Bitmap Images
//-------------------------------------------------------------------------------------------
static const unsigned char PROGMEM bitmap[] =
{
0x00, 0x00, 0x00, 0x00, 0x00, 0x00, 0x00, 0x00, 0x00, 0x00, 0x00, 0x00, 0x00, 0x00, 0x00, 0x00,
0x00, 0x00, 0x00, 0x00, 0x00, 0x00, 0x00, 0x00, 0x00, 0x00, 0x00, 0x00, 0x00, 0x00, 0x00, 0x00,
0x00, 0x00, 0x00, 0x00, 0x00, 0x00, 0x00, 0x00, 0x00, 0x00, 0x00, 0x00, 0x00, 0x00, 0x00, 0x00,
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0x00, 0x00, 0x00, 0x00, 0x00, 0x00, 0x00, 0x00, 0x00, 0x00, 0x00, 0x00, 0x00, 0x00, 0x00, 0x00
};

const unsigned char github_bmp_logo [357] PROGMEM = {
  0x00, 0x00, 0x07, 0xfe, 0x00, 0x00, 0x00, 0x00, 0x00, 0x7f, 0xff, 0xe0, 0x00, 0x00, 0x00, 0x01, 
  0xff, 0xff, 0xf8, 0x00, 0x00, 0x00, 0x07, 0xff, 0xff, 0xfe, 0x00, 0x00, 0x00, 0x1f, 0xff, 0xff, 
  0xff, 0x80, 0x00, 0x00, 0x3f, 0xff, 0xff, 0xff, 0xc0, 0x00, 0x00, 0x7f, 0xff, 0xff, 0xff, 0xe0, 
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  0x60, 0x00, 0x60, 0x00, 0x00
};

//-------------------------------------------------------------------------------------------
//Setup
//-------------------------------------------------------------------------------------------
void setup() {
  Serial.begin(115200);
  Serial.println("Starting blynk");
  Blynk.begin(auth, ssid, pass);
  Serial.println("success");
   pinMode(relay_1_pin, OUTPUT);
   pinMode(relay_2_pin, OUTPUT);
   pinMode(relay_3_pin, OUTPUT);
   pinMode(relay_4_pin, OUTPUT);
   digitalWrite(relay_1_pin, HIGH);
   digitalWrite(relay_2_pin, HIGH);
   digitalWrite(relay_3_pin, HIGH);
   digitalWrite(relay_4_pin, HIGH);
   
   //sense_pin_1.autoMidPoint();
  
  if(!display.begin(SSD1306_SWITCHCAPVCC, 0x3C)) { 
    Serial.println(F("SSD1306 allocation failed"));   
  }
  
display.clearDisplay();
  show_splash_bitmap();
  draw_github_details();
  progress_bar();
  
  //create a task that will be executed in the Task_Blynk_code_code() function, with priority 1 and executed on core 0
  xTaskCreatePinnedToCore(
                    Task_Blynk_code,   /* Task function. */
                    "Task_Blynk",     /* name of task. */
                    10000,       /* Stack size of task */
                    NULL,        /* parameter of the task */
                    6,           /* priority of the task */
                    &Task_Blynk,      /* Task handle to keep track of created task */
                    0);          /* pin task to core 0 */                  
  delay(500); 

  //create a task that will be executed in the Task_Draw_Dispaly_code() function, with priority 1 and executed on core 1
  xTaskCreatePinnedToCore(
                    Task_Draw_Dispaly_code,   /* Task function. */
                    "Task_Draw_Dispaly",     /* name of task. */
                    10000,       /* Stack size of task */
                    NULL,        /* parameter of the task */
                    7,           /* priority of the task */
                    &Task_Draw_Dispaly,      /* Task handle to keep track of created task */
                    1);          /* pin task to core 1 */
    delay(500);
    
    WiFi.mode(WIFI_STA);// Set device as a Wi-Fi Station 
    
    if (esp_now_init() == ESP_OK) {
         Serial.println("ESPNow Init Success");
      }
        else {
          Serial.println("err,ESPNow Init Failed");   
      ESP.restart();
        }
        
        esp_now_register_recv_cb(OnDataRecv);
        esp_now_register_send_cb(OnDataSent);
        
    Draw_Visual_System_Interface(); 
    delay(1000);
}
//-------------------------------------------------------------------------------------------
//-------------------------------------------------------------------------------------------
void loop() {
  vTaskDelete(NULL);
}
//-------------------------------------------------------------------------------------------
//-------------------------------------------------------------------------------------------

void Task_Blynk_code( void * pvParameters ){
  Serial.print("Task1 running on core ");
  Serial.println(xPortGetCoreID());

  for(;;){
        vTaskDelay( pdMS_TO_TICKS( 10 ) );
        Blynk.run();      
  } 
}
//-------------------------------------------------------------------------------------------
//-------------------------------------------------------------------------------------------
void Task_Draw_Dispaly_code( void * Parameters ){
  Serial.print("Task2 running on core ");
  Serial.println(xPortGetCoreID());
  unsigned long time_now = 0;
  for(;;){  
      time_now = millis();  
       // vTaskDelay( pdMS_TO_TICKS( 10 ) );
        Update_Display(Read_Current(), 0.0, 1.2, 2.0);
    while(millis() < time_now + 1000){
      //non blocking wait for 1000ms
      //alows proper firing of ESPnow callback     
    }
  }
}

//-------------------------------------------------------------------------------------------
//-------------------------------------------------------------------------------------------
void OnDataRecv(const uint8_t * mac,const uint8_t *incomingData, int len) 
{ 
     char* buff = (char*) incomingData;
     String buffStr = String(buff);
     buffStr.trim();
     Process_ESPnow_message(buffStr);
}
//-------------------------------------------------------------------------------------------
//-------------------------------------------------------------------------------------------
void Process_ESPnow_message(String message_in){
  Serial.println("message in=" + message_in);
  String sub_strings[20];
  int sub_string_count = 0;

  while (message_in.length() > 0)
  {
    int index = message_in.indexOf(',');
    if (index == -1) // No comma found
    {
      sub_strings[sub_string_count++] = message_in;
      break;
    }
    else
    {
      sub_strings[sub_string_count++] = message_in.substring(0, index);
      message_in = message_in.substring(index+1);
    }
  }

   for (int i = 0; i < sub_string_count; i++)
  {
    Serial.print(i);
    Serial.print(": \"");
    Serial.print(sub_strings[i]);
    Serial.println("\"");
  }

  //request from C# application to determine if Networked Smart 12V Power System is connected to ESPnow network 
  if(sub_strings[0] == "tst"){
    String unit_mac = WiFi.macAddress();
       Send_message("tst,spw ok,", unit_mac);
         }
  
}
//-------------------------------------------------------------------------------------------
//-------------------------------------------------------------------------------------------
void OnDataSent(const uint8_t *mac_addr, esp_now_send_status_t status) 
{   
     Serial.print("\r\nLast Packet Send Status:\t");
     Serial.println(status == ESP_NOW_SEND_SUCCESS ? "Delivery Success" : "Delivery Fail");
}
//-------------------------------------------------------------------------------------------
//-------------------------------------------------------------------------------------------
void Send_message(String outbound_message,String mac_ad)
{
   String outgoing = outbound_message + mac_ad;
   uint8_t *buff = (uint8_t*) outgoing.c_str();
   size_t sizeBuff = sizeof(buff) * outgoing.length();
   esp_now_send(broadcastAddress, buff, sizeBuff);
         
}
//-------------------------------------------------------------------------------------------
//-------------------------------------------------------------------------------------------
BLYNK_WRITE(V0)
{
  int pinValue = param.asInt(); // assigning incoming value from pin V0 to a variable

  
  if(pinValue > 0){
    Serial.println("High " + pinValue);
    digitalWrite(relay_1_pin, HIGH);
    relay_status_1 = 1;
  }
  else{
     Serial.println("Low " + pinValue);
    digitalWrite(relay_1_pin, LOW);
     relay_status_1 = 0;
  }
}

BLYNK_WRITE(V1)
{
  int pinValue = param.asInt(); // assigning incoming value from pin V0 to a variable

  
  if(pinValue > 0){
    Serial.println("High " + pinValue);
    digitalWrite(relay_2_pin, HIGH);
     relay_status_2 = 1;
  }
  else{
     Serial.println("Low " + pinValue);
    digitalWrite(relay_2_pin, LOW);
     relay_status_2 = 0;
  }
}

BLYNK_WRITE(V2)
{
  int pinValue = param.asInt(); // assigning incoming value from pin V0 to a variable

  
  if(pinValue > 0){
    Serial.println("High " + pinValue);
    digitalWrite(relay_3_pin, HIGH);
     relay_status_3 = 1;
  }
  else{
     Serial.println("Low " + pinValue);
    digitalWrite(relay_3_pin, LOW);
     relay_status_3 = 0;
  }
}

BLYNK_WRITE(V3)
{
  int pinValue = param.asInt(); // assigning incoming value from pin V0 to a variable

  
  if(pinValue > 0){
    Serial.println("High " + pinValue);
    digitalWrite(relay_4_pin, HIGH);
     relay_status_4 = 1;
  }
  else{
     Serial.println("Low " + pinValue);
    digitalWrite(relay_4_pin, LOW);
     relay_status_4 = 0;
  }
}
//-------------------------------------------------------------------------------------------
//Draw Bitmap Splashscreen
//-------------------------------------------------------------------------------------------
void show_splash_bitmap(void) {
  display.clearDisplay();
  display.drawBitmap(0, 0, bitmap, splash_height, splash_width, WHITE);
  display.display();
  delay(3000);
}
//-------------------------------------------------------------------------------------------
//Draw Bitmap image of Github Logo
//-------------------------------------------------------------------------------------------
void draw_github_details(void) {
  display.clearDisplay();
  display.drawBitmap(38, 0, github_bmp_logo,52,52,WHITE);
  display.setTextColor(WHITE);
  display.setTextSize(1);
  display.setCursor(26, 53);
  display.println("CountZero1066");
  display.display();
  delay(1500); //main program tasks have yet to be invoked, thus a blocking delay has no negative impact 
}
//-------------------------------------------------------------------------------------------
//Animated Loading Screen
//-------------------------------------------------------------------------------------------
void progress_bar(){  
  display.clearDisplay();
  display.setTextSize(2);
  display.setTextColor(WHITE);
  display.setCursor(22, 20);
  display.println("LOADING");
  display.display();

  display.drawRect(0, 44, 128, 20, WHITE);
  display.display();
  delay(1000);
  
  for(int i = 0; i <= 125; i = i + 5){
    display.fillRect(2, 46, i, 16, WHITE); 
    display.display();
    delay(50);
  }
  delay(1000);
}
//-------------------------------------------------------------------------------------------
//Draw Interface for SSD1306 OLED Display
//-------------------------------------------------------------------------------------------

//Function takes four double datatype parameters
//Parameters represent measured current draw via the read_A_sensor() function
void Draw_Visual_System_Interface(){
  
  display.clearDisplay();
  display.setTextSize(1);
  //Definition for the SSD1306 drawn graphics
  //Fout rows of rectangles of 16 pixel height,each with two other embedded rectangles.
  //The final rectangle, unlike the preceding two rectangles,is drawn filled. As such, the text occupying this-
  //-final rectangle is drawn in BLACK,as to contrast with the WHITE background

   for(int i = 0; i <=3; i++){
      display.drawRect(rec1_x[i], rec1_y[i], rec1_w[i], rec1_h[i], WHITE); //x, y, width, height (x & y determine the position of the top left corner of the box)
      display.drawRect(rec2_x[i], rec2_y[i], rec2_w[i], rec2_h[i], WHITE);
      display.fillRect(rec3_x[i], rec3_y[i], rec3_w[i], rec3_h[i], WHITE);  
      
      display.setTextColor(WHITE);
        display.setCursor(text_c1_x[i],text_c1_y[i]);
        display.println("Circuit " + String(i + 1 ));        
   }
   
  display.display();
}
//-------------------------------------------------------------------------------------------
//Update Display Data
//-------------------------------------------------------------------------------------------
void Update_Display(double cct1_A,double cct2_A,double cct3_A, double cct4_A){
  display.setTextSize(1);
  double cct_A[] = {cct1_A, cct2_A, cct3_A, cct4_A}; 
  int cct_stat[] =  {relay_status_1,relay_status_2,relay_status_3,relay_status_4,};
  String cct_status_array[4];
   
 for (int n = 0; n<=3;n++){
  if (cct_stat[n] == 0){
      cct_status_array[n] = "ON ";    
  }
  else{
    cct_status_array[n] = "OFF";
  }
 }  
    for(int i = 0; i <=3; i++){
        display.setTextColor(WHITE,BLACK);        
        display.setCursor(text_c2_x[i], text_c2_y[i]);
        display.println(cct_status_array[i]);
        display.setTextColor(BLACK,WHITE);
        display.setCursor(text_c3_x[i], text_c3_y[i]);
        display.println(String(cct_A[i],1));
  }
  display.display();
}

//-------------------------------------------------------------------------------------------
// Calculate Current Draw from each Relay
//-------------------------------------------------------------------------------------------
//double Read_Current(){
//  double mA = sense_pin_1.mA_AC();
//  return mA;
//}
double Read_Current(){
  int mA = analogRead(A_sensor1);
  double voltage = mA*3.3/4095;
  double current =(voltage -2.5)/0.185;

  if(current < 0){
    current = 0;
  }
  
  return current;
}
//-------------------------------------------------------------------------------------------
// 
//-------------------------------------------------------------------------------------------
int read_A_sensor(int sensor_read){

  int current_reading_out;
  Voltage = getVPP(sensor_read);
  VRMS = (Voltage/2.0) *0.707;
  AmpsRMS = ((VRMS * 1000)/mVperAmp)-17.67;
  current_reading_out = AmpsRMS;
  
  Serial.print(AmpsRMS);
  Serial.print(" Amps RMS  ---  ");

  return current_reading_out;
 
}

float getVPP(int sensor)
{
  float result;
  int readValue;                // value read from the sensor
  int maxValue = 0;             // store max value here
  int minValue = 4096;          // store min value here ESP32 ADC resolution
  
   uint32_t start_time = millis();
   while((millis()-start_time) < 250) //sample for 250ms
   {
       readValue = sensor;
       // see if you have a new maxValue
       if (readValue > maxValue) 
       {
           /*record the maximum sensor value*/
           maxValue = readValue;
       }
       if (readValue < minValue) 
       {
           /*record the minimum sensor value*/
           minValue = readValue;
       }
   }
   
   // Subtract min from max
   result = ((maxValue - minValue) * 5)/4096.0; //ESP32 ADC resolution 4096
      
   return result;
 }
